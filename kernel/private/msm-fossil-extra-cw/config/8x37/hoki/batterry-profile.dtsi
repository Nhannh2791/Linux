/*
 * Copyright (c) 2019-2020, The Linux Foundation. All rights reserved.
 *
 * This program is free software; you can redistribute it and/or modify
 * it under the terms of the GNU General Public License version 2 and
 * only version 2 as published by the Free Software Foundation.
 *
 * This program is distributed in the hope that it will be useful,
 * but WITHOUT ANY WARRANTY; without even the implied warranty of
 * MERCHANTABILITY or FITNESS FOR A PARTICULAR PURPOSE.  See the
 * GNU General Public License for more details.
 */
/ {
	/delete-node/ qcom,battery-data;
	hoki_batterydata: qcom,battery-data {
		qcom,batt-id-range-pct = <60>;
		#include "../common/fg-gen3-batterydata-lishen-300mah.dtsi"
	};
};

&pm660_fg {
	status = "ok";
	/* Set TWM threshold value */
	qcom,twm-soc-reserve = <3>;
	qcom,fg-cutoff-current = <40>;
	qcom,fg-cutoff-voltage = <3200>;
	qcom,battery-data = <&hoki_batterydata>;
};
