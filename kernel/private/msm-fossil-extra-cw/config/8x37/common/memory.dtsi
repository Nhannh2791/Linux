/*
 * Copyright (c) 2019-2020, The Linux Foundation. All rights reserved.
 *
 * This program is free software; you can redistribute it and/or modify
 * it under the terms of the GNU General Public License version 2 and
 * only version 2 as published by the Free Software Foundation.
 *
 * This program is distributed in the hope that it will be useful,
 * but WITHOUT ANY WARRANTY; without even the implied warranty of
 * MERCHANTABILITY or FITNESS FOR A PARTICULAR PURPOSE.  See the
 * GNU General Public License for more details.
 */

/* TODO:
 * optimize memory when building chipcode for GPS mode ready
*/
#if 0
&modem_mem {
	reg = <0x0 0x86800000 0x0 0x1e00000>;
};

&adsp_fw_mem {
	reg = <0x0 0x88600000 0x0 0x1500000>;
};
&wcnss_fw_mem {
	reg = <0x0 0x89b00000 0x0 0x700000>;
};
#else
&modem_mem {
	reg = <0x0 0x86800000 0x0 0x5000000> ;
};

&adsp_fw_mem {
	reg = <0x0 0x8b800000 0x0 0x1500000>;
};
&wcnss_fw_mem {
	reg = <0x0 0x8cd00000 0x0 0x700000>;
};
#endif
