/*
 * Copyright (c) 2015-2016, 2018-2019, 2002 The Linux Foundation. All rights reserved.
 *
 * This program is free software; you can redistribute it and/or modify
 * it under the terms of the GNU General Public License version 2 and
 * only version 2 as published by the Free Software Foundation.
 *
 * This program is distributed in the hope that it will be useful,
 * but WITHOUT ANY WARRANTY; without even the implied warranty of
 * MERCHANTABILITY or FITNESS FOR A PARTICULAR PURPOSE.  See the
 * GNU General Public License for more details.
 */

/* Disable nq@28 of i2c_5 */
&i2c_5 {
	nq@28 {
		status = "disabled";
	};
};

&i2c_2 { /* BLSP2 QUP2 (NFC) */
        status = "ok";
        nq@28 {
                compatible = "qcom,nq-nci";
                reg = <0x28>;
                qcom,nq-irq = <&tlmm 126 0x00>;
                qcom,nq-ven = <&tlmm 125 0x00>;
                qcom,nq-firm = <&tlmm 130 0x00>;
                qcom,nq-clkreq = <&pm660_gpios 4 0x00>;
                qcom,nq-esepwr = <&tlmm 93 0x00>;
                interrupt-parent = <&tlmm>;
                qcom,clk-src = "BBCLK2";
                interrupts = <126 0>;
                interrupt-names = "nfc_irq";
                pinctrl-names = "nfc_active", "nfc_suspend";
                pinctrl-0 = <&nfc_int_active &nfc_disable_active
                                                &nfc_clk_default>;
                pinctrl-1 = <&nfc_int_suspend &nfc_disable_suspend>;
                /* TODO: Need to check clocks */
                clocks = <&rpmcc 32>;
                clock-names = "ref_clk";
        };
};
